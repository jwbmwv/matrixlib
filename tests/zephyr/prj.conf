## CMakeLists.txt
```
# SPDX-License-Identifier: MIT
# MatrixLib Zephyr Test Suite

cmake_minimum_required(VERSION 3.20.0)

find_package(Zephyr REQUIRED HINTS $ENV{ZEPHYR_BASE})
project(matrixlib_tests)

# Add test sources
target_sources(app PRIVATE
    src/test_constants.cpp
    src/test_vec.cpp
    src/test_mat.cpp
    src/test_quat.cpp
    src/test_main.cpp
)
```

## prj.conf
```kconfig
# Zephyr Test Configuration for MatrixLib

# Enable MatrixLib module
CONFIG_MATRIXLIB=y

# Enable CMSIS-DSP optimizations (optional, comment out for non-ARM platforms)
# CONFIG_MATRIX_LINEAR_CMSIS=y

# Ztest framework
CONFIG_ZTEST=y
CONFIG_ZTEST_NEW_API=y

# Increase main stack size for floating-point operations
CONFIG_MAIN_STACK_SIZE=4096

# Enable floating-point support
CONFIG_FPU=y

# Console and logging
CONFIG_CONSOLE=y
CONFIG_PRINTK=y
CONFIG_LOG=y
CONFIG_LOG_DEFAULT_LEVEL=3

# Increase heap size for dynamic allocations (if needed)
CONFIG_HEAP_MEM_POOL_SIZE=4096
```

## src/test_constants.cpp
```c
// SPDX-License-Identifier: MIT
/// @file test_constants.cpp
/// @brief MatrixLib Zephyr Test Suite - Constants Tests
/// @details Unit tests for mathematical constants in the constants namespace.
/// @copyright Copyright (c) 2026 James Baldwin
/// @author James Baldwin

#include <zephyr/ztest.h>
#include <matrixlib/constants.hpp>
#include <math.h>

using namespace matrixlib;

// Precision for floating point comparisons
#define FLOAT_EPSILON 1e-6f
#define DOUBLE_EPSILON 1e-12

// ==================== Fundamental Constants Tests ====================

ZTEST(matrixlib_constants, test_pi_precision)
{
    zassert_within(constants::pi<float>, 3.14159265f, FLOAT_EPSILON, "Pi (float) precision");
    zassert_within(constants::pi<double>, 3.14159265358979323846, DOUBLE_EPSILON, "Pi (double) precision");
}

ZTEST(matrixlib_constants, test_pi_derivatives)
{
    // Two pi
    zassert_within(constants::two_pi<float>, 2.0f * constants::pi<float>, FLOAT_EPSILON, "Two pi");

    // Half pi
    zassert_within(constants::half_pi<float>, constants::pi<float> / 2.0f, FLOAT_EPSILON, "Half pi");

    // Quarter pi
    zassert_within(constants::quarter_pi<float>, constants::pi<float> / 4.0f, FLOAT_EPSILON, "Quarter pi");
}

ZTEST(matrixlib_constants, test_euler_number)
{
    zassert_within(constants::e<float>, 2.71828182f, FLOAT_EPSILON, "Euler's number");
}

ZTEST(matrixlib_constants, test_golden_ratio)
{
    // Golden ratio = (1 + sqrt(5)) / 2
    float phi_calculated = (1.0f + sqrtf(5.0f)) / 2.0f;
    zassert_within(constants::golden_ratio<float>, phi_calculated, 1e-5f, "Golden ratio");
}

ZTEST(matrixlib_constants, test_square_roots)
{
    zassert_within(constants::sqrt2<float>, sqrtf(2.0f), FLOAT_EPSILON, "Square root of 2");
    zassert_within(constants::sqrt3<float>, sqrtf(3.0f), FLOAT_EPSILON, "Square root of 3");
}

ZTEST(matrixlib_constants, test_natural_logarithms)
{
    zassert_within(constants::ln2<float>, logf(2.0f), FLOAT_EPSILON, "Natural log of 2");
    zassert_within(constants::ln10<float>, logf(10.0f), FLOAT_EPSILON, "Natural log of 10");
}

// ==================== Conversion Factor Tests ====================

ZTEST(matrixlib_constants, test_degree_radian_conversion)
{
    // deg_to_rad = pi / 180
    float deg_to_rad_calculated = constants::pi<float> / 180.0f;
    zassert_within(constants::deg_to_rad<float>, deg_to_rad_calculated, FLOAT_EPSILON, "Degrees to radians");

    // rad_to_deg = 180 / pi
    float rad_to_deg_calculated = 180.0f / constants::pi<float>;
    zassert_within(constants::rad_to_deg<float>, rad_to_deg_calculated, FLOAT_EPSILON, "Radians to degrees");

    // Round-trip conversion
    float degrees = 90.0f;
    float radians = degrees * constants::deg_to_rad<float>;
    float back_to_degrees = radians * constants::rad_to_deg<float>;
    zassert_within(back_to_degrees, degrees, 1e-5f, "Round-trip conversion");
}

ZTEST(matrixlib_constants, test_conversion_examples)
{
    // 90 degrees = pi/2 radians
    zassert_within(90.0f * constants::deg_to_rad<float>, constants::half_pi<float>, 1e-5f, "90 degrees");

    // 180 degrees = pi radians
    zassert_within(180.0f * constants::deg_to_rad<float>, constants::pi<float>, 1e-5f, "180 degrees");

    // 360 degrees = 2*pi radians
    zassert_within(360.0f * constants::deg_to_rad<float>, constants::two_pi<float>, 1e-5f, "360 degrees");
}

// ==================== Epsilon Tests ====================

ZTEST(matrixlib_constants, test_epsilon_values)
{
    zassert_equal(constants::epsilon_f, 1e-6f, "Single precision epsilon");
    zassert_equal(constants::epsilon_d, 1e-12, "Double precision epsilon");
}

// ==================== Physical Constants Tests ====================

ZTEST(matrixlib_constants, test_physical_constants)
{
    // Standard gravity
    zassert_within(constants::gravity<float>, 9.80665f, 1e-5f, "Standard gravity");

    // Speed of light (exact value)
    zassert_equal(constants::speed_of_light<float>, 299792458.0f, "Speed of light");
}

// ==================== Constexpr Tests ====================

ZTEST(matrixlib_constants, test_constexpr_evaluation)
{
    // These should compile successfully - verifies constexpr works
    constexpr float pi_constexpr = constants::pi<float>;
    constexpr float half_pi_constexpr = constants::half_pi<float>;
    constexpr float deg_to_rad_constexpr = constants::deg_to_rad<float>;

    zassert_within(pi_constexpr, 3.14159265f, FLOAT_EPSILON, "Constexpr pi");
    zassert_within(half_pi_constexpr, 1.5707963f, FLOAT_EPSILON, "Constexpr half pi");
    zassert_within(deg_to_rad_constexpr, 0.01745329f, FLOAT_EPSILON, "Constexpr deg_to_rad");
}

// ==================== Real-World Usage Tests ====================

ZTEST(matrixlib_constants, test_real_world_usage)
{
    // Circle circumference: C = 2 * pi * r
    float radius = 5.0f;
    float circumference = constants::two_pi<float> * radius;
    zassert_within(circumference, 31.415926f, 1e-5f, "Circle circumference");

    // Right triangle with 45-degree angle
    float angle_45_rad = 45.0f * constants::deg_to_rad<float>;
    zassert_within(angle_45_rad, constants::quarter_pi<float>, 1e-5f, "45 degree angle");
}

ZTEST(matrixlib_constants, test_independent_usage)
{
    // Verify constants.hpp can be used independently
    float area_of_circle = constants::pi<float> * 10.0f * 10.0f;
    zassert_within(area_of_circle, 314.159265f, 1e-4f, "Circle area");
}
```

## src/test_main.cpp
```c
// SPDX-License-Identifier: MIT
/// @file test_main.cpp
/// @brief MatrixLib Zephyr Test Suite - Main Entry Point
/// @details Test suite setup and teardown for Zephyr ztest framework.
/// @copyright Copyright (c) 2026 James Baldwin
/// @author James Baldwin

#include <zephyr/ztest.h>

// Test suite setup and teardown
static void* matrixlib_setup(void)
{
    printk("MatrixLib Test Suite Starting...\n");
    return NULL;
}

static void matrixlib_before(void* f)
{
    ARG_UNUSED(f);
}

static void matrixlib_after(void* f)
{
    ARG_UNUSED(f);
}

static void matrixlib_teardown(void* f)
{
    ARG_UNUSED(f);
    printk("MatrixLib Test Suite Complete\n");
}

// Register test suites (defined in other files)
extern void register_vec_tests(void);
extern void register_mat_tests(void);
extern void register_quat_tests(void);

ZTEST_SUITE(matrixlib_constants, NULL, matrixlib_setup, matrixlib_before, matrixlib_after, matrixlib_teardown);
ZTEST_SUITE(matrixlib_vec, NULL, matrixlib_setup, matrixlib_before, matrixlib_after, matrixlib_teardown);
ZTEST_SUITE(matrixlib_mat, NULL, matrixlib_setup, matrixlib_before, matrixlib_after, matrixlib_teardown);
ZTEST_SUITE(matrixlib_quat, NULL, matrixlib_setup, matrixlib_before, matrixlib_after, matrixlib_teardown);
```

## src/test_mat.cpp
```c
// SPDX-License-Identifier: MIT
/// @file test_mat.cpp
/// @brief MatrixLib Zephyr Test Suite - Mat<T,R,C> Tests
/// @details Comprehensive unit tests for matrix operations using Zephyr ztest framework.
/// @copyright Copyright (c) 2026 James Baldwin
/// @author James Baldwin

#include <zephyr/ztest.h>
#include <matrixlib/matrixlib.hpp>
#include <cmath>

using namespace matrixlib;

// Use epsilon consistent with library's comparison tolerance (epsilon * 100)
// std::numeric_limits<float>::epsilon() is ~1.19e-7, so * 100 gives ~1.19e-5
#define FLOAT_EPSILON (std::numeric_limits<float>::epsilon() * 100.0f)

static bool float_eq(float a, float b)
{
    return std::fabs(a - b) < FLOAT_EPSILON;
}

ZTEST(matrixlib_mat, test_mat_construction)
{
    Mat<float, 2, 2> m1;
    SquareMat<float, 3> m2 = SquareMat<float, 3>::identity();

    zassert_true(float_eq(m2[0][0], 1.0f), "Identity [0][0] should be 1");
    zassert_true(float_eq(m2[0][1], 0.0f), "Identity [0][1] should be 0");
    zassert_true(float_eq(m2[1][1], 1.0f), "Identity [1][1] should be 1");
}

ZTEST(matrixlib_mat, test_mat_addition)
{
    Mat<float, 2, 2> a;
    a[0][0] = 1.0f;
    a[0][1] = 2.0f;
    a[1][0] = 3.0f;
    a[1][1] = 4.0f;

    Mat<float, 2, 2> b;
    b[0][0] = 5.0f;
    b[0][1] = 6.0f;
    b[1][0] = 7.0f;
    b[1][1] = 8.0f;

    Mat<float, 2, 2> sum = a + b;

    zassert_true(float_eq(sum[0][0], 6.0f), "sum[0][0] should be 6");
    zassert_true(float_eq(sum[1][1], 12.0f), "sum[1][1] should be 12");
}

ZTEST(matrixlib_mat, test_mat_multiplication)
{
    Mat<float, 2, 3> a;
    a[0][0] = 1.0f;
    a[0][1] = 2.0f;
    a[0][2] = 3.0f;
    a[1][0] = 4.0f;
    a[1][1] = 5.0f;
    a[1][2] = 6.0f;

    Mat<float, 3, 2> b;
    b[0][0] = 7.0f;
    b[0][1] = 8.0f;
    b[1][0] = 9.0f;
    b[1][1] = 10.0f;
    b[2][0] = 11.0f;
    b[2][1] = 12.0f;

    Mat<float, 2, 2> c = a * b;

    // Expected: [58, 64]
    //           [139, 154]
    zassert_true(float_eq(c[0][0], 58.0f), "c[0][0] should be 58");
    zassert_true(float_eq(c[0][1], 64.0f), "c[0][1] should be 64");
    zassert_true(float_eq(c[1][0], 139.0f), "c[1][0] should be 139");
    zassert_true(float_eq(c[1][1], 154.0f), "c[1][1] should be 154");
}

ZTEST(matrixlib_mat, test_mat_vector_mult)
{
    SquareMat<float, 2> m;
    m[0][0] = 1.0f;
    m[0][1] = 2.0f;
    m[1][0] = 3.0f;
    m[1][1] = 4.0f;

    Vec<float, 2> v(5.0f, 6.0f);
    Vec<float, 2> result = m * v;

    // Expected: [1*5 + 2*6, 3*5 + 4*6] = [17, 39]
    zassert_true(float_eq(result[0], 17.0f), "result[0] should be 17");
    zassert_true(float_eq(result[1], 39.0f), "result[1] should be 39");
}

ZTEST(matrixlib_mat, test_mat_transpose)
{
    Mat<float, 2, 3> m;
    m[0][0] = 1.0f;
    m[0][1] = 2.0f;
    m[0][2] = 3.0f;
    m[1][0] = 4.0f;
    m[1][1] = 5.0f;
    m[1][2] = 6.0f;

    Mat<float, 3, 2> mt = m.transpose();

    zassert_true(float_eq(mt[0][0], 1.0f), "mt[0][0] should be 1");
    zassert_true(float_eq(mt[0][1], 4.0f), "mt[0][1] should be 4");
    zassert_true(float_eq(mt[1][0], 2.0f), "mt[1][0] should be 2");
    zassert_true(float_eq(mt[2][1], 6.0f), "mt[2][1] should be 6");
}

ZTEST(matrixlib_mat, test_mat_determinant_2x2)
{
    SquareMat<float, 2> m;
    m[0][0] = 1.0f;
    m[0][1] = 2.0f;
    m[1][0] = 3.0f;
    m[1][1] = 4.0f;

    float det = m.determinant();

    // det = 1*4 - 2*3 = -2
    zassert_true(float_eq(det, -2.0f), "Determinant should be -2");
}

ZTEST(matrixlib_mat, test_mat_determinant_3x3)
{
    SquareMat<float, 3> m;
    m[0][0] = 1.0f;
    m[0][1] = 2.0f;
    m[0][2] = 3.0f;
    m[1][0] = 0.0f;
    m[1][1] = 1.0f;
    m[1][2] = 4.0f;
    m[2][0] = 5.0f;
    m[2][1] = 6.0f;
    m[2][2] = 0.0f;

    float det = m.determinant();

    // det = 1*(1*0-4*6) - 2*(0*0-4*5) + 3*(0*6-1*5) = 1*(-24) - 2*(-20) + 3*(-5) = -24 + 40 - 15 = 1
    zassert_true(float_eq(det, 1.0f), "Determinant should be 1");
}

ZTEST(matrixlib_mat, test_mat_trace)
{
    SquareMat<float, 3> m;
    m[0][0] = 1.0f;
    m[0][1] = 2.0f;
    m[0][2] = 3.0f;
    m[1][0] = 4.0f;
    m[1][1] = 5.0f;
    m[1][2] = 6.0f;
    m[2][0] = 7.0f;
    m[2][1] = 8.0f;
    m[2][2] = 9.0f;

    float trace = m.trace();

    // trace = 1 + 5 + 9 = 15
    zassert_true(float_eq(trace, 15.0f), "Trace should be 15");
}

ZTEST(matrixlib_mat, test_mat_inverse_2x2)
{
    SquareMat<float, 2> m;
    m[0][0] = 4.0f;
    m[0][1] = 7.0f;
    m[1][0] = 2.0f;
    m[1][1] = 6.0f;

    SquareMat<float, 2> inv = m.inverse();
    SquareMat<float, 2> identity = m * inv;

    zassert_true(float_eq(identity[0][0], 1.0f), "M * M^-1 [0][0] should be 1");
    zassert_true(float_eq(identity[0][1], 0.0f), "M * M^-1 [0][1] should be 0");
    zassert_true(float_eq(identity[1][0], 0.0f), "M * M^-1 [1][0] should be 0");
    zassert_true(float_eq(identity[1][1], 1.0f), "M * M^-1 [1][1] should be 1");
}

ZTEST(matrixlib_mat, test_rotation_2d)
{
    float angle = 3.14159f / 2.0f;  // 90 degrees
    SquareMat<float, 2> R = SquareMat<float, 2>::rotation(angle);

    Vec<float, 2> v(1.0f, 0.0f);
    Vec<float, 2> rotated = R * v;

    // Should rotate to (0, 1)
    zassert_true(float_eq(rotated[0], 0.0f), "rotated.x should be ~0");
    zassert_true(float_eq(rotated[1], 1.0f), "rotated.y should be ~1");
}

ZTEST(matrixlib_mat, test_rotation_3d_x)
{
    float angle = 3.14159f / 2.0f;  // 90 degrees
    SquareMat<float, 3> Rx = SquareMat<float, 3>::rotation_x(angle);

    Vec<float, 3> y(0.0f, 1.0f, 0.0f);
    Vec<float, 3> rotated = Rx * y;

    // Should rotate Y to Z
    zassert_true(float_eq(rotated[0], 0.0f), "rotated.x should be ~0");
    zassert_true(float_eq(rotated[1], 0.0f), "rotated.y should be ~0");
    zassert_true(float_eq(rotated[2], 1.0f), "rotated.z should be ~1");
}

ZTEST(matrixlib_mat, test_rotation_3d_y)
{
    float angle = 3.14159f / 2.0f;  // 90 degrees
    SquareMat<float, 3> Ry = SquareMat<float, 3>::rotation_y(angle);

    Vec<float, 3> z(0.0f, 0.0f, 1.0f);
    Vec<float, 3> rotated = Ry * z;

    // Should rotate Z to X
    zassert_true(float_eq(rotated[0], 1.0f), "rotated.x should be ~1");
    zassert_true(float_eq(rotated[1], 0.0f), "rotated.y should be ~0");
    zassert_true(float_eq(rotated[2], 0.0f), "rotated.z should be ~0");
}

ZTEST(matrixlib_mat, test_rotation_3d_z)
{
    float angle = 3.14159f / 2.0f;  // 90 degrees
    SquareMat<float, 3> Rz = SquareMat<float, 3>::rotation_z(angle);

    Vec<float, 3> x(1.0f, 0.0f, 0.0f);
    Vec<float, 3> rotated = Rz * x;

    // Should rotate X to Y
    zassert_true(float_eq(rotated[0], 0.0f), "rotated.x should be ~0");
    zassert_true(float_eq(rotated[1], 1.0f), "rotated.y should be ~1");
    zassert_true(float_eq(rotated[2], 0.0f), "rotated.z should be ~0");
}

ZTEST(matrixlib_mat, test_rotation_axis_angle)
{
    Vec<float, 3> axis(0.0f, 0.0f, 1.0f);
    float angle = 3.14159f / 2.0f;

    SquareMat<float, 3> R = SquareMat<float, 3>::rotation_axis_angle(axis, angle);
    Vec<float, 3> x(1.0f, 0.0f, 0.0f);
    Vec<float, 3> rotated = R * x;

    zassert_true(float_eq(rotated[1], 1.0f), "Should rotate X to Y around Z axis");
}

ZTEST(matrixlib_mat, test_rotation_from_to)
{
    Vec<float, 3> from(1.0f, 0.0f, 0.0f);
    Vec<float, 3> to(0.0f, 1.0f, 0.0f);

    SquareMat<float, 3> R = SquareMat<float, 3>::rotation_from_to(from, to);
    Vec<float, 3> result = R * from;

    zassert_true(float_eq(result[0], to[0]), "result.x should match to.x");
    zassert_true(float_eq(result[1], to[1]), "result.y should match to.y");
    zassert_true(float_eq(result[2], to[2]), "result.z should match to.z");
}

ZTEST(matrixlib_mat, test_look_at)
{
    Vec<float, 3> target(1.0f, 0.0f, 0.0f);
    Vec<float, 3> up(0.0f, 0.0f, 1.0f);

    SquareMat<float, 3> look = SquareMat<float, 3>::look_at(target, up);

    // First column should be target direction
    Vec<float, 3> forward(look[0][0], look[1][0], look[2][0]);
    float mag = forward.magnitude();

    zassert_true(float_eq(mag, 1.0f), "Forward vector should be normalized");
    zassert_true(float_eq(forward[0], 1.0f), "Should point in target direction");
}

ZTEST(matrixlib_mat, test_euler_angles)
{
    float roll = 0.1f;
    float pitch = 0.2f;
    float yaw = 0.3f;

    SquareMat<float, 3> Rx = SquareMat<float, 3>::rotation_x(roll);
    SquareMat<float, 3> Ry = SquareMat<float, 3>::rotation_y(pitch);
    SquareMat<float, 3> Rz = SquareMat<float, 3>::rotation_z(yaw);

    SquareMat<float, 3> R = Rz * Ry * Rx;
    Vec<float, 3> angles = R.euler_angles();

    // Should extract approximately the same angles
    zassert_true(float_eq(angles[0], roll), "Roll should match");
    zassert_true(float_eq(angles[1], pitch), "Pitch should match");
    zassert_true(float_eq(angles[2], yaw), "Yaw should match");
}
```

## src/test_quat.cpp
```c
// SPDX-License-Identifier: MIT
/// @file test_quat.cpp
/// @brief MatrixLib Zephyr Test Suite - Quaternion<T> Tests
/// @details Comprehensive unit tests for quaternion operations using Zephyr ztest framework.
/// @copyright Copyright (c) 2026 James Baldwin
/// @author James Baldwin

#include <zephyr/ztest.h>
#include <matrixlib/quaternion.hpp>
#include <cmath>

using namespace matrixlib;

#define FLOAT_EPSILON 0.0001f

static bool float_eq(float a, float b)
{
    return std::fabs(a - b) < FLOAT_EPSILON;
}

ZTEST(matrixlib_quat, test_quat_construction)
{
    Quaternion<float> q1;                          // Identity
    Quaternion<float> q2(1.0f, 0.0f, 0.0f, 0.0f);  // w, x, y, z

    zassert_true(float_eq(q1.w(), 1.0f), "Identity w should be 1");
    zassert_true(float_eq(q1.x(), 0.0f), "Identity x should be 0");

    zassert_true(float_eq(q2.w(), 1.0f), "q2.w should be 1");
    zassert_true(float_eq(q2.x(), 0.0f), "q2.x should be 0");
}

ZTEST(matrixlib_quat, test_quat_axis_angle)
{
    Vec<float, 3> axis(0.0f, 0.0f, 1.0f);
    float angle = 3.14159f / 2.0f;  // 90 degrees

    Quaternion<float> q(axis, angle);

    // For 90° around Z: w = cos(45°) ≈ 0.707, z = sin(45°) ≈ 0.707
    zassert_true(float_eq(q.w(), 0.7071f), "w should be ~0.707");
    zassert_true(float_eq(q.z(), 0.7071f), "z should be ~0.707");
    zassert_true(float_eq(q.x(), 0.0f), "x should be 0");
    zassert_true(float_eq(q.y(), 0.0f), "y should be 0");
}

ZTEST(matrixlib_quat, test_quat_conjugate)
{
    Quaternion<float> q(1.0f, 2.0f, 3.0f, 4.0f);
    Quaternion<float> qc = q.conjugate();

    zassert_true(float_eq(qc.w(), 1.0f), "conjugate w unchanged");
    zassert_true(float_eq(qc.x(), -2.0f), "conjugate x negated");
    zassert_true(float_eq(qc.y(), -3.0f), "conjugate y negated");
    zassert_true(float_eq(qc.z(), -4.0f), "conjugate z negated");
}

ZTEST(matrixlib_quat, test_quat_norm)
{
    Quaternion<float> q(1.0f, 2.0f, 2.0f, 0.0f);
    float n = q.norm();

    // norm = sqrt(1 + 4 + 4 + 0) = sqrt(9) = 3
    zassert_true(float_eq(n, 3.0f), "Norm should be 3");
}

ZTEST(matrixlib_quat, test_quat_normalize)
{
    Quaternion<float> q(2.0f, 2.0f, 2.0f, 2.0f);
    Quaternion<float> qn = q.normalized();

    float norm = qn.norm();
    zassert_true(float_eq(norm, 1.0f), "Normalized quaternion should have norm 1");

    // Each component should be 0.5
    zassert_true(float_eq(qn.w(), 0.5f), "qn.w should be 0.5");
    zassert_true(float_eq(qn.x(), 0.5f), "qn.x should be 0.5");
}

ZTEST(matrixlib_quat, test_quat_multiplication)
{
    Vec<float, 3> z_axis(0.0f, 0.0f, 1.0f);
    Vec<float, 3> x_axis(1.0f, 0.0f, 0.0f);

    Quaternion<float> q1(z_axis, 3.14159f / 2.0f);  // 90° around Z
    Quaternion<float> q2(x_axis, 3.14159f / 2.0f);  // 90° around X

    Quaternion<float> q3 = q1 * q2;

    // Combined rotation
    float norm = q3.norm();
    zassert_true(float_eq(norm, 1.0f), "Product should be unit quaternion");
}

ZTEST(matrixlib_quat, test_quat_inverse)
{
    Vec<float, 3> axis(0.0f, 0.0f, 1.0f);
    Quaternion<float> q(axis, 3.14159f / 4.0f);

    Quaternion<float> qi = q.inverse();
    Quaternion<float> identity = q * qi;

    zassert_true(float_eq(identity.w(), 1.0f), "q * q^-1 should be identity");
    zassert_true(float_eq(identity.x(), 0.0f), "q * q^-1 x should be 0");
    zassert_true(float_eq(identity.y(), 0.0f), "q * q^-1 y should be 0");
    zassert_true(float_eq(identity.z(), 0.0f), "q * q^-1 z should be 0");
}

ZTEST(matrixlib_quat, test_quat_rotate_vector)
{
    Vec<float, 3> axis(0.0f, 0.0f, 1.0f);
    Quaternion<float> q(axis, 3.14159f / 2.0f);  // 90° around Z

    Vec<float, 3> v(1.0f, 0.0f, 0.0f);
    Vec<float, 3> rotated = q.rotate(v);

    // Should rotate X to Y
    zassert_true(float_eq(rotated[0], 0.0f), "rotated.x should be ~0");
    zassert_true(float_eq(rotated[1], 1.0f), "rotated.y should be ~1");
    zassert_true(float_eq(rotated[2], 0.0f), "rotated.z should be ~0");
}

ZTEST(matrixlib_quat, test_quat_to_rotation_matrix)
{
    Vec<float, 3> axis(0.0f, 0.0f, 1.0f);
    Quaternion<float> q(axis, 3.14159f / 2.0f);

    SquareMat<float, 3> R = q.to_rotation_matrix();
    Vec<float, 3> v(1.0f, 0.0f, 0.0f);
    Vec<float, 3> rotated = R * v;

    // Should rotate X to Y
    zassert_true(float_eq(rotated[0], 0.0f), "matrix rotated.x should be ~0");
    zassert_true(float_eq(rotated[1], 1.0f), "matrix rotated.y should be ~1");
}

ZTEST(matrixlib_quat, test_quat_from_rotation_matrix)
{
    SquareMat<float, 3> R = SquareMat<float, 3>::rotation_z(3.14159f / 2.0f);
    Quaternion<float> q = Quaternion<float>::from_rotation_matrix(R);

    // Should be 90° rotation around Z
    zassert_true(float_eq(q.w(), 0.7071f), "w should be ~0.707");
    zassert_true(float_eq(q.z(), 0.7071f), "z should be ~0.707");
}

ZTEST(matrixlib_quat, test_quat_slerp)
{
    Quaternion<float> q_start = Quaternion<float>::identity();

    Vec<float, 3> axis(0.0f, 0.0f, 1.0f);
    Quaternion<float> q_end(axis, 3.14159f / 2.0f);

    // Interpolate at t=0.5 (halfway)
    Quaternion<float> q_mid = q_start.slerp(q_end, 0.5f);

    // Should be 45° rotation
    Vec<float, 3> v(1.0f, 0.0f, 0.0f);
    Vec<float, 3> rotated = q_mid.rotate(v);

    // At 45°, x and y should be equal
    zassert_true(float_eq(rotated[0], rotated[1]), "At 45°, x and y should be equal");
    zassert_true(float_eq(rotated[2], 0.0f), "z should remain 0");
}

ZTEST(matrixlib_quat, test_quat_addition)
{
    Quaternion<float> q1(1.0f, 0.0f, 0.0f, 0.0f);
    Quaternion<float> q2(0.0f, 1.0f, 0.0f, 0.0f);

    Quaternion<float> sum = q1 + q2;

    zassert_true(float_eq(sum.w(), 1.0f), "sum.w should be 1");
    zassert_true(float_eq(sum.x(), 1.0f), "sum.x should be 1");
    zassert_true(float_eq(sum.y(), 0.0f), "sum.y should be 0");
}

ZTEST(matrixlib_quat, test_quat_scalar_mult)
{
    Quaternion<float> q(1.0f, 2.0f, 3.0f, 4.0f);
    Quaternion<float> scaled = q * 2.0f;

    zassert_true(float_eq(scaled.w(), 2.0f), "scaled.w should be 2");
    zassert_true(float_eq(scaled.x(), 4.0f), "scaled.x should be 4");
    zassert_true(float_eq(scaled.y(), 6.0f), "scaled.y should be 6");
    zassert_true(float_eq(scaled.z(), 8.0f), "scaled.z should be 8");
}

ZTEST(matrixlib_quat, test_quat_identity)
{
    Quaternion<float> q = Quaternion<float>::identity();

    Vec<float, 3> v(1.0f, 2.0f, 3.0f);
    Vec<float, 3> rotated = q.rotate(v);

    // Identity rotation should not change vector
    zassert_true(float_eq(rotated[0], v[0]), "identity preserves x");
    zassert_true(float_eq(rotated[1], v[1]), "identity preserves y");
    zassert_true(float_eq(rotated[2], v[2]), "identity preserves z");
}

ZTEST(matrixlib_quat, test_quat_vec_accessor)
{
    Quaternion<float> q(1.0f, 2.0f, 3.0f, 4.0f);

    Vec<float, 3>& v = q.vec();

    zassert_true(float_eq(v[0], 2.0f), "vec[0] should be x = 2");
    zassert_true(float_eq(v[1], 3.0f), "vec[1] should be y = 3");
    zassert_true(float_eq(v[2], 4.0f), "vec[2] should be z = 4");

    // Modify through reference
    v[0] = 5.0f;
    zassert_true(float_eq(q.x(), 5.0f), "Modifying vec should affect quaternion");
}

ZTEST(matrixlib_quat, test_quat_compound_assignment)
{
    Quaternion<float> q(1.0f, 0.0f, 0.0f, 0.0f);
    Quaternion<float> a(1.0f, 1.0f, 1.0f, 1.0f);

    q += a;
    zassert_true(float_eq(q.w(), 2.0f), "q.w should be 2 after +=");

    q -= a;
    zassert_true(float_eq(q.w(), 1.0f), "q.w should be 1 after -=");

    q *= 2.0f;
    zassert_true(float_eq(q.w(), 2.0f), "q.w should be 2 after *= 2");
}
```

## src/test_vec.cpp
```c
// SPDX-License-Identifier: MIT
/// @file test_vec.cpp
/// @brief MatrixLib Zephyr Test Suite - Vec<T,N> Tests
/// @details Comprehensive unit tests for vector operations using Zephyr ztest framework.
/// @copyright Copyright (c) 2026 James Baldwin
/// @author James Baldwin

#include <zephyr/ztest.h>
#include <matrixlib/matrixlib.hpp>
#include <cmath>

using namespace matrixlib;

#define FLOAT_EPSILON 0.0001f

// Helper to compare floats
static bool float_eq(float a, float b)
{
    return std::fabs(a - b) < FLOAT_EPSILON;
}

ZTEST(matrixlib_vec, test_vec_construction)
{
    Vec<float, 3> v1;
    Vec<float, 3> v2(1.0f, 2.0f, 3.0f);
    Vec<float, 3> v3(v2);

    zassert_true(float_eq(v2[Vec<float, 3>::X], 1.0f), "v2.x should be 1.0");
    zassert_true(float_eq(v2[Vec<float, 3>::Y], 2.0f), "v2.y should be 2.0");
    zassert_true(float_eq(v2[Vec<float, 3>::Z], 3.0f), "v2.z should be 3.0");

    zassert_true(float_eq(v3[0], v2[0]), "Copy constructor failed");
}

ZTEST(matrixlib_vec, test_vec_addition)
{
    Vec<float, 3> a(1.0f, 2.0f, 3.0f);
    Vec<float, 3> b(4.0f, 5.0f, 6.0f);
    Vec<float, 3> sum = a + b;

    zassert_true(float_eq(sum[0], 5.0f), "sum[0] should be 5.0");
    zassert_true(float_eq(sum[1], 7.0f), "sum[1] should be 7.0");
    zassert_true(float_eq(sum[2], 9.0f), "sum[2] should be 9.0");
}

ZTEST(matrixlib_vec, test_vec_subtraction)
{
    Vec<float, 3> a(4.0f, 5.0f, 6.0f);
    Vec<float, 3> b(1.0f, 2.0f, 3.0f);
    Vec<float, 3> diff = a - b;

    zassert_true(float_eq(diff[0], 3.0f), "diff[0] should be 3.0");
    zassert_true(float_eq(diff[1], 3.0f), "diff[1] should be 3.0");
    zassert_true(float_eq(diff[2], 3.0f), "diff[2] should be 3.0");
}

ZTEST(matrixlib_vec, test_vec_scalar_multiplication)
{
    Vec<float, 3> v(1.0f, 2.0f, 3.0f);
    Vec<float, 3> scaled = v * 2.0f;

    zassert_true(float_eq(scaled[0], 2.0f), "scaled[0] should be 2.0");
    zassert_true(float_eq(scaled[1], 4.0f), "scaled[1] should be 4.0");
    zassert_true(float_eq(scaled[2], 6.0f), "scaled[2] should be 6.0");
}

ZTEST(matrixlib_vec, test_vec_dot_product)
{
    Vec<float, 3> a(1.0f, 0.0f, 0.0f);
    Vec<float, 3> b(0.0f, 1.0f, 0.0f);
    Vec<float, 3> c(1.0f, 2.0f, 3.0f);
    Vec<float, 3> d(4.0f, 5.0f, 6.0f);

    float dot1 = a.dot(b);
    float dot2 = c.dot(d);

    zassert_true(float_eq(dot1, 0.0f), "Orthogonal vectors should have dot product 0");
    zassert_true(float_eq(dot2, 32.0f), "dot(c,d) should be 32.0");
}

ZTEST(matrixlib_vec, test_vec_cross_product)
{
    Vec<float, 3> x(1.0f, 0.0f, 0.0f);
    Vec<float, 3> y(0.0f, 1.0f, 0.0f);
    Vec<float, 3> z = x.cross(y);

    zassert_true(float_eq(z[Vec<float, 3>::X], 0.0f), "z.x should be 0");
    zassert_true(float_eq(z[Vec<float, 3>::Y], 0.0f), "z.y should be 0");
    zassert_true(float_eq(z[Vec<float, 3>::Z], 1.0f), "z.z should be 1");
}

ZTEST(matrixlib_vec, test_vec_magnitude)
{
    Vec<float, 3> v(3.0f, 4.0f, 0.0f);
    float mag = v.magnitude();

    zassert_true(float_eq(mag, 5.0f), "Magnitude of (3,4,0) should be 5.0");
}

ZTEST(matrixlib_vec, test_vec_normalization)
{
    Vec<float, 3> v(3.0f, 4.0f, 0.0f);
    Vec<float, 3> n = v.normalized();
    float mag = n.magnitude();

    zassert_true(float_eq(mag, 1.0f), "Normalized vector should have magnitude 1.0");
    zassert_true(float_eq(n[0], 0.6f), "n.x should be 0.6");
    zassert_true(float_eq(n[1], 0.8f), "n.y should be 0.8");
}

ZTEST(matrixlib_vec, test_vec_angle)
{
    Vec<float, 3> x(1.0f, 0.0f, 0.0f);
    Vec<float, 3> y(0.0f, 1.0f, 0.0f);
    Vec<float, 3> diag(1.0f, 1.0f, 0.0f);

    float angle1 = x.angle(y);
    float angle2 = x.angle(diag);

    zassert_true(float_eq(angle1, 3.14159f / 2.0f), "Angle between x and y should be 90°");
    zassert_true(float_eq(angle2, 3.14159f / 4.0f), "Angle should be 45°");
}

ZTEST(matrixlib_vec, test_vec_project_reject)
{
    Vec<float, 3> a(3.0f, 4.0f, 0.0f);
    Vec<float, 3> b(1.0f, 0.0f, 0.0f);

    Vec<float, 3> proj = a.project(b);
    Vec<float, 3> rej = a.reject(b);

    // proj should be along b direction
    zassert_true(float_eq(proj[0], 3.0f), "proj.x should be 3.0");
    zassert_true(float_eq(proj[1], 0.0f), "proj.y should be 0.0");

    // rej should be perpendicular to b
    zassert_true(float_eq(rej[0], 0.0f), "rej.x should be 0.0");
    zassert_true(float_eq(rej[1], 4.0f), "rej.y should be 4.0");

    // proj + rej should equal original
    Vec<float, 3> sum = proj + rej;
    zassert_true(float_eq(sum[0], a[0]), "sum.x should equal a.x");
    zassert_true(float_eq(sum[1], a[1]), "sum.y should equal a.y");
}

ZTEST(matrixlib_vec, test_vec_signed_angle)
{
    Vec<float, 3> x(1.0f, 0.0f, 0.0f);
    Vec<float, 3> y(0.0f, 1.0f, 0.0f);
    Vec<float, 3> z(0.0f, 0.0f, 1.0f);

    float angle_xy_z = x.signed_angle(y, z);
    float angle_yx_z = y.signed_angle(x, z);

    zassert_true(angle_xy_z > 0.0f, "Angle from x to y around z should be positive");
    zassert_true(angle_yx_z < 0.0f, "Angle from y to x around z should be negative");
}

ZTEST(matrixlib_vec, test_vec_accessors)
{
    Vec<float, 3> v(1.0f, 2.0f, 3.0f);

    zassert_true(float_eq(v.x(), 1.0f), "v.x() should be 1.0");
    zassert_true(float_eq(v.y(), 2.0f), "v.y() should be 2.0");
    zassert_true(float_eq(v.z(), 3.0f), "v.z() should be 3.0");

    v.x() = 4.0f;
    zassert_true(float_eq(v.x(), 4.0f), "v.x() = 4.0 should work");
}

ZTEST(matrixlib_vec, test_vec_compound_assignment)
{
    Vec<float, 3> v(1.0f, 2.0f, 3.0f);
    Vec<float, 3> a(1.0f, 1.0f, 1.0f);

    v += a;
    zassert_true(float_eq(v[0], 2.0f), "v[0] should be 2.0 after +=");

    v -= a;
    zassert_true(float_eq(v[0], 1.0f), "v[0] should be 1.0 after -=");

    v *= 2.0f;
    zassert_true(float_eq(v[0], 2.0f), "v[0] should be 2.0 after *= 2");

    v /= 2.0f;
    zassert_true(float_eq(v[0], 1.0f), "v[0] should be 1.0 after /= 2");
}
```

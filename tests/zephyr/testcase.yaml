## tests/zephyr/testcase.yaml
```yaml
# SPDX-License-Identifier: MIT
# MatrixLib Test Suite Configuration

tests:
  libraries.matrixlib:
    tags:
      - matrixlib
      - math
      - linear_algebra
    platform_allow:
      - qemu_cortex_m3
      - qemu_cortex_m0
      - native_posix
      - native_sim
    integration_platforms:
      - qemu_cortex_m3
      - native_posix
    harness: ztest
    min_ram: 32
```

## zephyr/Kconfig
```kconfig
# Copyright (c) 2026 MatrixLib Contributors
# SPDX-License-Identifier: MIT

config MATRIXLIB
	bool "MatrixLib - Linear Algebra Library"
	help
	  Enable MatrixLib header-only linear algebra library.
	  Provides Vec, Mat, SquareMat, and Quaternion classes
	  optimized for embedded systems.

if MATRIXLIB

config MATRIXLIB_DEBUG
	bool "Enable debug assertions and bounds checking"
	default n
	help
	  Enable runtime assertions and bounds checking in MatrixLib.
	  When enabled, the at() accessor methods will perform bounds
	  checking using assert() in debug builds. This adds minimal
	  overhead but helps catch out-of-bounds access during development.
	  Recommended for development and testing, disable for production.

config MATRIXLIB_NEON
	bool "Enable ARM NEON optimizations"
	depends on CPU_CORTEX_A || ARM64
	help
	  Enable ARM NEON SIMD acceleration for vector, matrix,
	  and quaternion operations on ARM Cortex-A processors
	  and ARM64 platforms (including Apple Silicon).
	  Provides significant performance improvements for
	  float32 operations on vectors of size 2, 3, and 4.
	  Also defines MATRIXLIB_ENABLE_NEON for compatibility
	  with non-Zephyr build switches.

config MATRIXLIB_CMSIS
	bool "Enable CMSIS-DSP optimizations"
	depends on CMSIS_DSP
	help
	  Enable CMSIS-DSP hardware acceleration for vector,
	  matrix, and quaternion operations on ARM Cortex-M
	  processors. Requires CMSIS-DSP to be enabled.
	  Also defines MATRIXLIB_ENABLE_CMSIS for compatibility
	  with non-Zephyr build switches.

config MATRIXLIB_MVE
	bool "Enable ARM MVE (Helium) optimizations"
	depends on CPU_CORTEX_M
	help
	  Enable ARM MVE (Helium) SIMD acceleration for vector,
	  matrix, and quaternion operations on Cortex-M processors
	  that support MVE. This option is intended for Cortex-M
	  profiles with Helium extensions.
	  Also defines MATRIXLIB_ENABLE_MVE for compatibility
	  with non-Zephyr build switches.

endif # MATRIXLIB
```
